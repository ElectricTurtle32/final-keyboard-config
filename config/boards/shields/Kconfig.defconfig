## config/boards/shields/Kconfig.defconfig
```kconfig
if SHIELD_LILYKEY_LEFT
config ZMK_KEYBOARD_NAME
    default "LilyKey Left"
endif

if SHIELD_LILYKEY_RIGHT
config ZMK_KEYBOARD_NAME
    default "LilyKey Right"
endif
```

## config/boards/shields/Kconfig.shield
```kconfig
config SHIELD_LILLYKEY_LEFT
    def_bool $(shields_list_contains,lillykey_left)

config SHIELD_LILLYKEY_RIGHT
    def_bool $(shields_list_contains,lillykey_right)
```

## config/boards/shields/lilykey_left/Kconfig.defconfig
```kconfig
if SHIELD_LILYKEY_LEFT
config ZMK_KEYBOARD_NAME
    default "LilyKey Left"
endif
```

## config/boards/shields/lilykey_right/Kconfig.defconfig
```kconfig
if SHIELD_LILYKEY_RIGHT
config ZMK_KEYBOARD_NAME
    default "LilyKey Right"
endif
```
